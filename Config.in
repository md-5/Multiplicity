## Config.in
```kconfig
source "$BR2_EXTERNAL/package/libvirt/Config.in"
source "$BR2_EXTERNAL/package/qemu/Config.in"
```

## configs/multiplicity_defconfig
```kconfig
BR2_x86_64=y
BR2_DEFCONFIG="$(CONFIG_DIR)/defconfig"
BR2_CCACHE=y
BR2_OPTIMIZE_3=y
BR2_TOOLCHAIN_BUILDROOT_EGLIBC=y
BR2_TARGET_GENERIC_GETTY_PORT="tty1"
BR2_ROOTFS_OVERLAY="$(BR2_EXTERNAL)/board/multiplicity/fs-overlay/"
BR2_ROOTFS_POST_BUILD_SCRIPT="$(BR2_EXTERNAL)/board/multiplicity/post-build.sh"
BR2_LINUX_KERNEL=y
BR2_LINUX_KERNEL_DEFCONFIG="x86_64"
BR2_PACKAGE_JAMVM=y
BR2_PACKAGE_OPENSSH=y
BR2_TARGET_ROOTFS_CPIO_XZ=y
BR2_TARGET_ROOTFS_ISO9660=y
BR2_PACKAGE_LIBVIRT=y
BR2_PACKAGE_QEMU=y
BR2_PACKAGE_QEMU_SYSTEM=y
BR2_PACKAGE_QEMU_LINUX_USER=y
BR2_PACKAGE_QEMU_TOOLS_ON_TARGET=y
BR2_PACKAGE_QEMU_VNC=y
BR2_PACKAGE_QEMU_VNC_PNG=y
BR2_PACKAGE_QEMU_VNC_JPEG=y
BR2_PACKAGE_QEMU_VNC_TLS=y
BR2_PACKAGE_QEMU_CURSES=y
BR2_PACKAGE_QEMU_VIRTFS=y
BR2_PACKAGE_QEMU_CURL=y
BR2_PACKAGE_QEMU_ISCSI=y
BR2_PACKAGE_QEMU_VDE=y
BR2_PACKAGE_QEMU_MIXEMU=y
BR2_PACKAGE_QEMU_SOUND_ALSA=y
BR2_PACKAGE_QEMU_SOUND_SDL=y
BR2_PACKAGE_QEMU_FDT=y
BR2_PACKAGE_QEMU_SECCOMP=y
```

## package/libvirt/Config.in
```kconfig
comment "libvirt needs an (e)glibc toolchain"
    depends on !BR2_TOOLCHAIN_USES_GLIBC

config BR2_PACKAGE_LIBVIRT
    bool "libvirt"
    depends on BR2_TOOLCHAIN_USES_GLIBC
    select BR2_PACKAGE_YAJL
    select BR2_PACKAGE_LVM2
    select BR2_PACKAGE_LIBNL
    select BR2_PACKAGE_LIBXML2

    help
      libvirt is a toolkit to interact with the virtualization
      capabilities of recent versions of Linux (and other OSes).

      http://libvirt.org/
```

## package/qemu/Config.in
```kconfig
comment "QEMU requires an x86 toolchain with threads"
	depends on BR2_i386 || BR2_x86_64
	depends on !BR2_TOOLCHAIN_HAS_THREADS

menuconfig BR2_PACKAGE_QEMU
	bool "QEMU"
	depends on BR2_i386 || BR2_x86_64
	depends on BR2_TOOLCHAIN_HAS_THREADS
	select BR2_PACKAGE_LIBGLIB2
	select BR2_PACKAGE_PIXMAN
	help
	  QEMU is a generic and open source machine emulator and virtualizer.

	  When used as a machine emulator, QEMU can run OSes and programs made
	  for one machine (e.g. an ARM board) on a different machine (e.g.
	  your own PC). By using dynamic translation, it achieves very good
	  performance.

	  When used as a virtualizer, QEMU achieves near native performances
	  by executing the guest code directly on the host CPU. QEMU supports
	  virtualization when executing under the Xen hypervisor or using the
	  KVM kernel module in Linux. When using KVM, QEMU can virtualize x86,
	  server and embedded PowerPC, and S390 guests.

	  http://qemu.org/
```
